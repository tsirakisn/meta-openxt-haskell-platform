## conf/layer.conf
```bitbake
# We have a conf and classes directory, append to BBPATH
BBPATH .= ":${LAYERDIR}"

# We have a recipes directory, add to BBFILES
BBFILES += " \
    ${LAYERDIR}/recipes-*/*/*.bb \
    ${LAYERDIR}/recipes-*/*/*.bbappend \
    ${LAYERDIR}/recipes-*/*/*/*.bb \
    ${LAYERDIR}/recipes-*/*/*/*.bbappend \
    ${LAYERDIR}/recipes-*/*/*/*/*.bb \
    ${LAYERDIR}/recipes-*/*/*/*/*.bbappend \
"

BBFILE_COLLECTIONS += "meta-openxt-haskell-platform"
BBFILE_PATTERN_meta-openxt-haskell-platform := "^${LAYERDIR}/"
BBFILE_PRIORITY_meta-openxt-haskell-platform = "9"

LICENSE_PATH += "${LAYERDIR}/files/additional-licenses"

LAYERVERSION_meta-openxt-haskell-platform = "1"

HOSTTOOLS += " \
    ghc \
    ghc-pkg \
"
```
